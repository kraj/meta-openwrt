## conf/distro/nodistro.conf
```bitbake
VIRTUAL-RUNTIME_dev_manager ?= "procd"
VIRTUAL-RUNTIME_login_manager ?= "busybox"
VIRTUAL-RUNTIME_init_manager ?= "procd"
VIRTUAL-RUNTIME_kmod_manager ?= "ubox"
VIRTUAL-RUNTIME_syslog ?= "ubox"
VIRTUAL-RUNTIME_base-utils ?= "busybox"

DISTRO_FEATURES_BACKFILL_CONSIDERED_append = "sysvinit systemd"

INHERIT += "openwrt-kmods openwrt-services"
```

## conf/layer.conf
```bitbake
# We have a conf and classes directory, append to BBPATH
BBPATH .= ":${LAYERDIR}"

# We have a recipes directory, add to BBFILES
BBFILES += "${LAYERDIR}/recipes*/*/*.bb ${LAYERDIR}/recipes*/*/*.bbappend"

BBFILE_COLLECTIONS += "openwrt-layer"
BBFILE_PATTERN_openwrt-layer := "^${LAYERDIR}/"
BBFILE_PRIORITY_openwrt-layer = "8"

LAYERDEPENDS_openwrt-layer = "core openembedded-layer networking-layer"

LAYERSERIES_COMPAT_openwrt-layer = "nanbield scarthgap"
```
